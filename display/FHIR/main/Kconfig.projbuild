## display/FHIR/main/Kconfig.projbuild
```kconfig
# put here your custom config value
menu "Example Configuration"
	config ESP_WIFI_SSID
	    string "WiFi SSID"
	    default "myssid"
	    help
		SSID (network name) for the example to connect to.

	config ESP_WIFI_PASSWORD
	    string "WiFi Password"
	    default "mypassword"
	    help
		WiFi password (WPA or WPA2) for the example to use.

	enu "Example Configuration"

    menu "I2C Master"
        config I2C_MASTER_SCL
            int "SCL GPIO Num"
            default 19
            help
                GPIO number for I2C Master clock line.

        config I2C_MASTER_SDA
            int "SDA GPIO Num"
            default 18
            help
                GPIO number for I2C Master data line.

        config I2C_MASTER_PORT_NUM
            int "Port Number"
            default 1
            help
                Port number for I2C Master device.

        config I2C_MASTER_FREQUENCY
            int "Master Frequency"
            default 100000
            help
                I2C Speed of Master device.
    endmenu

    menu "I2C Slave"
        config I2C_SLAVE_SCL
            int "SCL GPIO Num"
            default 26
            help
                GPIO number for I2C Slave clock line.

        config I2C_SLAVE_SDA
            int "SDA GPIO Num"
            default 25
            help
                GPIO number for I2C Slave data line.

        config I2C_SLAVE_PORT_NUM
            int "Port Number"
            default 0
            help
                Port number for I2C Slave device.

        config I2C_SLAVE_ADDRESS
            hex "ESP Slave Address"
            default 0x28
            help
                Hardware Address of I2C Slave Port.
    endmenu
endmenu
```
